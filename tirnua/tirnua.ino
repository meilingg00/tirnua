#include <Wire.h>
#include <Adafruit_GFX.h>
#include <Adafruit_SSD1306.h>
#include <Adafruit_MPU6050.h>

#define I2C_SDA 21
#define I2C_SCL 22
#define WATER_SENSOR_PIN 34   
#define WATER_THRESHOLD 400   
#define BUZZER_PIN 5          
#define TILT_THRESHOLD 30.0   

#define SCREEN_WIDTH 128
#define SCREEN_HEIGHT 64
#define OLED_RESET -1    
#define SCREEN_ADDRESS 0x3C

#define FRAME_DELAY 150       

// bitmaps
const unsigned char turtle_sleep0 [] PROGMEM = {
  0x00, 0x00, 0x00, 0x00, 0x00, 0x00, 0x00, 0x00, 0x00, 0x00, 0x00, 0x00, 0x00, 0x00, 0x00, 0x00, 
  0x00, 0x00, 0x00, 0x00, 0x00, 0x00, 0x00, 0x00, 0x00, 0x00, 0x00, 0x00, 0x00, 0x00, 0x00, 0x00, 
  0x00, 0x00, 0x00, 0x00, 0x00, 0x00, 0x00, 0x00, 0x00, 0x00, 0x00, 0x00, 0x00, 0x00, 0x00, 0x00, 
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  0x00, 0x00, 0x00, 0x00, 0x00, 0x00, 0x00, 0x00, 0x00, 0x00, 0x00, 0x00, 0x00, 0x00, 0x00, 0x00
};

const unsigned char turtle_awake0 [] PROGMEM = {
  0x00, 0x00, 0x00, 0x00, 0x00, 0x00, 0x00, 0x00, 0x00, 0x00, 0x00, 0x00, 0x00, 0x00, 0x00, 0x00, 
  0x00, 0x00, 0x00, 0x00, 0x00, 0x00, 0x00, 0x00, 0x00, 0x00, 0x00, 0x00, 0x00, 0x00, 0x00, 0x00, 
  0x00, 0x00, 0x00, 0x00, 0x00, 0x00, 0x00, 0x00, 0x00, 0x00, 0x00, 0x00, 0x00, 0x00, 0x00, 0x00, 
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  0x00, 0x00, 0x00, 0x00, 0x00, 0x00, 0x00, 0x00, 0x00, 0x00, 0x00, 0x00, 0x00, 0x00, 0x00, 0x00
};

const unsigned char turtle_awake1 [] PROGMEM = {
  0x00, 0x00, 0x00, 0x00, 0x00, 0x00, 0x00, 0x00, 0x00, 0x00, 0x00, 0x00, 0x00, 0x00, 0x00, 0x00, 
  0x00, 0x00, 0x00, 0x00, 0x00, 0x00, 0x00, 0x00, 0x00, 0x00, 0x00, 0x00, 0x00, 0x00, 0x00, 0x00, 
  0x00, 0x00, 0x00, 0x00, 0x00, 0x00, 0x00, 0x00, 0x00, 0x00, 0x00, 0x00, 0x00, 0x00, 0x00, 0x00, 
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  0x00, 0x00, 0x00, 0x00, 0x00, 0x00, 0x00, 0x00, 0x00, 0x00, 0x00, 0x00, 0x00, 0x00, 0x00, 0x00
};

// animation handlers
const unsigned char* drinkingAnimation[] = {
  turtle_awake0,
  turtle_awake1
};
int drinkingFrameCount = 2;

Adafruit_MPU6050 mpu;
Adafruit_SSD1306 display(SCREEN_WIDTH, SCREEN_HEIGHT, &Wire, OLED_RESET);

float baseTiltX = 0.0;
float baseTiltY = 0.0;
int score = 0;

// timer and state logic
unsigned long drinkStartTime = 0;
bool timerActive = false;

int currentFrameIndex = 0;
unsigned long lastFrameTime = 0;

bool successActive = false;      
int successPhase = 0;            // 0=beeping 1=waiting 2=show score
unsigned long successPhaseStart = 0;
unsigned long lastBuzzerToggle = 0;
int beepCount = 0;

void setupOLED() {
  if (!display.begin(SSD1306_SWITCHCAPVCC, SCREEN_ADDRESS, false, false)) {
    Serial.println(F("SSD1306 allocation failed. Check wiring/address."));
    for (;;);
  }
  display.clearDisplay();
  display.display();
  delay(500);

  display.clearDisplay();
  display.setTextSize(1);
  display.setTextColor(SSD1306_WHITE);
  display.setCursor(0,0);
  display.println("Initializing...");
  display.display();
}

void calibrateMPU() {
  display.clearDisplay();
  display.setCursor(0, 0);
  display.setTextSize(2);
  display.println("Calibrating...");
  display.setTextSize(1);
  display.println("Keep Level & Still");
  display.display();

  sensors_event_t a, g, temp;
  for (int i = 0; i < 50; i++) {
    mpu.getEvent(&a, &g, &temp);
    delay(5);
  }

  mpu.getEvent(&a, &g, &temp);
  baseTiltX = atan2(a.acceleration.x, a.acceleration.z) * 180 / PI;
  baseTiltY = atan2(a.acceleration.y, a.acceleration.z) * 180 / PI;

  display.clearDisplay();
  display.setCursor(0, 0);
  display.setTextSize(2);
  display.println("Ready!");
  display.display();
  delay(1000);
}

void setup() {
  Serial.begin(115200);
  
  pinMode(WATER_SENSOR_PIN, INPUT);
  pinMode(BUZZER_PIN, OUTPUT);
  digitalWrite(BUZZER_PIN, LOW);

  Wire.begin(I2C_SDA, I2C_SCL);
  setupOLED();

  if (!mpu.begin()) {
    Serial.println("MPU6050 connection error.");
    while (1) { delay(1000); }
  }

  mpu.setAccelerometerRange(MPU6050_RANGE_8_G);
  mpu.setGyroRange(MPU6050_RANGE_500_DEG);
  mpu.setFilterBandwidth(MPU6050_BAND_21_HZ);

  calibrateMPU();
}

void loop() {
  unsigned long currentMillis = millis();

  // skip all this if success sequence is active
  if (!successActive) {
    
    // water level stuff - lock if no water present
    int waterLevel = analogRead(WATER_SENSOR_PIN);
    if (waterLevel < WATER_THRESHOLD) {
      display.clearDisplay();
      display.setTextSize(1);       
      display.setTextColor(SSD1306_WHITE);
      display.setCursor(0, 10);
      display.println("No water detected,");
      display.println("please fill water.");
      display.setCursor(0, 50);
      display.print("Val: "); display.print(waterLevel);
      display.display();
      
      timerActive = false;
      return; 
    }

    // mpu
    sensors_event_t a, g, temp;
    mpu.getEvent(&a, &g, &temp);
    
    float currentTiltX = atan2(a.acceleration.x, a.acceleration.z) * 180 / PI;
    float currentTiltY = atan2(a.acceleration.y, a.acceleration.z) * 180 / PI;

    float relativeTiltX = abs(currentTiltX - baseTiltX);
    float relativeTiltY = abs(currentTiltY - baseTiltY);
    
    float relativeTilt = (relativeTiltX > relativeTiltY) ? relativeTiltX : relativeTiltY;

    // drinking logic
    if (relativeTilt >= TILT_THRESHOLD) {
      if (!timerActive) {
        drinkStartTime = millis();
        timerActive = true;
      }

      // hold 3 secs if we're drinking at proper posture
      if (millis() - drinkStartTime >= 3000) {
        successActive = true;
        successPhase = 0;
        successPhaseStart = millis();
        beepCount = 0;
        lastBuzzerToggle = millis();
        timerActive = false; 
      }
    } else {
      timerActive = false;
      drinkStartTime = 0;
    }
  }

  // for when we hold posture successfully
  if (successActive) {
    // beep and play animation
    if (successPhase == 0) {
      if (currentMillis - lastBuzzerToggle >= 150) {
        lastBuzzerToggle = currentMillis;
        int state = digitalRead(BUZZER_PIN);
        digitalWrite(BUZZER_PIN, !state);
        
        beepCount++;
        if (beepCount >= 6) {
           digitalWrite(BUZZER_PIN, LOW); 
           successPhase = 1;
           successPhaseStart = currentMillis;
        }
      }
    }
    // wait & count to 2
    else if (successPhase == 1) {
       if (currentMillis - successPhaseStart >= 2000) {
         score++;
         successPhase = 2;
         successPhaseStart = currentMillis;
       }
    }
    // show score
    else if (successPhase == 2) {
       if (currentMillis - successPhaseStart >= 2000) {
         successActive = false;
       }
    }
  }
  
  // oled stuff
  display.clearDisplay();
  
  // show score
  if (successActive && successPhase == 2) {
    display.setTextColor(SSD1306_WHITE);
    display.setTextSize(4);
    display.setCursor(30, 10);
    display.println("+1");
    display.setTextSize(1);
    display.setCursor(30, 50);
    display.print("Total Score: ");
    display.print(score);
  }

  // drinking anim
  else if (timerActive || (successActive && successPhase < 2)) {
    if (currentMillis - lastFrameTime > FRAME_DELAY) {
      lastFrameTime = currentMillis;
      currentFrameIndex++;
      if (currentFrameIndex >= drinkingFrameCount) currentFrameIndex = 0;
    }
    display.drawBitmap(0, 0, drinkingAnimation[currentFrameIndex], 128, 64, SSD1306_WHITE);

    // countdown
    if (!successActive) {
      int secondsLeft = 3 - ((millis() - drinkStartTime) / 1000);
      display.setTextColor(SSD1306_INVERSE); 
      display.setTextSize(3);
      display.setCursor(100, 40); 
      display.print(secondsLeft);
    }
  }

  // sleeping still frame
  else {
    display.drawBitmap(0, 0, turtle_sleep0, 128, 64, SSD1306_WHITE);
    
    // total score overlay
    display.setTextColor(SSD1306_INVERSE);
    display.setTextSize(1);
    display.setCursor(0, 0);
    display.print("Score: "); 
    display.print(score);
  }

  display.display();
}